## build/Kconfig/Kconfig.shield.defconfig
```kconfig
osource "c:/users/petrikas.lu/desktop/work/nrf/nrf52_learning/boards/shields/*/Kconfig.defconfig"
osource "C:/ncs/v2.4.0/nrf/boards/shields/*/Kconfig.defconfig"
```

## build_1/Kconfig/Kconfig.shield
```kconfig
osource "c:/users/petrikas.lu/desktop/work/nrf/nrf52_learning/boards/shields/*/Kconfig.shield"
osource "C:/ncs/v2.4.0/nrf/boards/shields/*/Kconfig.shield"
```
